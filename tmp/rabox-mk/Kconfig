## tmp/rabox-mk/Kconfig
```kconfig
#
# For a description of the syntax of this configuration file,
# see scripts/kbuild/config-language.txt.
#

mainmenu "Network Services Configuration"

menu 'Generic Options'

config VENDOR_SHORT
	string "Short termed vendor name"
	default "Soliton"

config VENDOR_LONG
	string "Fully qualified vendor name"
	default "Soliton Network Systems (Shanghai) Co., Ltd"

config PRODUCT_SHORT
	string "Short termed product name"
	default "authbox"

config PRODUCT_LONG
	string "Fully qualified product name"
	default "Soliton Authentication Box"

config MODULE
	bool "Support link stage modules"
	default y

config HAVE_DOT_CONFIG
	bool
	default y

endmenu

source "lib/Kconfig"
source "kern/Kconfig"
source "fs/Kconfig"
source "net/Kconfig"
source "ui/Kconfig"
source "crypto/Kconfig"
source "appls/Kconfig"

menu 'Debugging Options'

config DEBUG
	bool "Build with extra Debugging symbols"
	default n
	help
	  Say Y here if you wish to examine internals while applets are
	  running.  This increases the size of the binary considerably, and
	  should only be used when doing development.  If you are doing
	  development and want to debug, answer Y.

	  Most people should answer N.

config WERROR
	bool "Abort compilation on any warning"
	default n
	help
	  Selecting this will add -Werror to gcc command line.

	  Most people should answer N.

choice
	prompt "Additional debugging library"
	default NO_DEBUG_LIB
	help
	  Using an additional debugging library will this program become
	  considerable larger and will cause it to run more slowly.  You
	  should always leave this option disabled for production use.

	  dmalloc support:
	  ----------------
	  This enables compiling with dmalloc ( http://dmalloc.com/ )
	  which is an excellent public domain mem leak and malloc problem
	  detector.  To enable dmalloc, before running you will
	  want to properly set your environment, for example:
	    export DMALLOC_OPTIONS=debug=0x34f47d83,inter=100,log=logfile
	  The 'debug=' value is generated using the following command
	    dmalloc -p log-stats -p log-non-free -p log-bad-space -p log-elapsed-time \
	       -p check-fence -p check-heap -p check-lists -p check-blank \
	       -p check-funcs -p realloc-copy -p allow-free-null

	  Electric-fence support:
	  -----------------------
	  This enables compiling with Electric-fence support.  Electric
	  fence is another very useful malloc debugging library which uses
	  your computer's virtual memory hardware to detect illegal memory
	  accesses.  This support will make this program be considerable larger
	  and run slower, so you should leave this option disabled unless
	  you are hunting a hard to find memory problem.


config NO_DEBUG_LIB
	bool "None"

config DMALLOC
	bool "Dmalloc"

config EFENCE
	bool "Electric-fence"

endchoice

endmenu

menu 'Installation Options'

config PREFIX
	string "Program installation prefix"
	default "/opt/netbox"
	help
	  Define your directory to install program files/subdirs in.

endmenu
```

## trunk/tmp/appls/Kconfig
```kconfig
#
# Network Appliances
#

menu "Network Appliances"
source "appls/vtss/Kconfig"
endmenu
```

## trunk/tmp/appls/vtss/Kconfig
```kconfig
#
# Vitesse Switches
#

menuconfig VTSS
	bool "Vitesse switch board support"
	default y
	help

if VTSS

config VTSS_ARCH_SPARX
	bool

config VTSS_ARCH_SPARX_28
	bool

config VTSS_ARCH_HEATHROW
	bool

choice
	prompt "Vitesse chip type selection"

config VTSS_GROCX
	bool "VSC7501 G-Roc'X"
	select VTSS_ARCH_SPARX
	select VTSS_ARCH_SPARX_28
	select VTSS_ARCH_HEATHROW
	select VTSS_ROUTER

endchoice

choice
	prompt "Vitesse board type selection"

config VTSS_BOARD_GROCX_REF
	bool "VSC7501 G-Roc'X Reference"

endchoice

config VTSS_VITGENIO
	bool "Enable Vitesse generic IO (vitgenio) support"
	default y

config VTSS_API
	bool "Enable Vitesse switch PHY API support"
	default y

config VTSS_FORCE_CPLD_MIIM
	bool "Configure to force CPLD MIIM ioctl"
	default n

config VTSS_PORT_COUNT
	int "Select number of ports"
	default 7 if VTSS_GROCX

config VTSS_ROUTER
	bool "Vitesse router-on-a-chip support"
	default y if VTSS_GROCX
	help
	  The router includes the following setup:
	    
	     +-------+
	     | Router|  
	     +-------+
	         | Router port(s)
	   +----------+
	   |  Switch  |      
	   +----------+
	    | | | |  | <-- WAN port (optional)  
	   (LAN ports)     
	 
	   By default, all ports are VLAN unaware and included in VLAN 1 only.
	   If an optional WAN port is specified, the following VLAN setup is
	   used:
	   - LAN ports in VLAN 1
	   - WAN port in VLAN 2
	   - Router port is in both VLANs and sends tagged frames.
	   - G-RocX: If a second router port is present, the first router port
	     is in VLAN 1 and the second router port is in VLAN 2. Both router
		 ports then send untagged frames.

if VTSS_ROUTER

config VTSS_ROUTER_PORT_FLOW_CONTROL
	bool "Select router port flow control mode"
	default y

config VTSS_ROUTER_PORT_WAN
	int "Select router WAN port"
	range 0 5
	default 1 if VTSS_GROCX
	default 0
	help
	  WAN port value:
	     0  : No WAN port is present
		 1-5: Selected port is WAN port

config VTSS_ROUTER_VLAN_LAN
	int "Select router LAN VLAN ID"
	range 1 4095
	default 1

config VTSS_ROUTER_VLAN_WAN
	int "Select router WAN VLAN ID"
	range 1 4095
	depends VTSS_ROUTER_PORT_WAN != 0
	default 2

config VTSS_ROUTER_PORT_5_IF
	bool "Enable GMII on chip port 5"
	depends VTSS_GROCX
	default n
	help
	  Set this to 'y' to enable GMII on chip port 5 on G-RocX
	  (default RGMII)

endif

config VTSS_MAC_NEXT_MAX
	int "Number of updated MAC table entries for get next traversal"
	range 0 65536
	default 1024
	help
	  Must be multiple of 4. The value zero means disabled

config VTSS_ACL
	bool "Enable ACL support"
	depends on VTSS_ARCH_HEATHROW
	default n

config VTSS_CPU_FRAME
	bool "Enable CPU frame extration / injection support"
	default n

config VTSS_EXTERNAL_CPU_VERIPHY
	bool "Enable external CPU VeriPHY"
	default y

config VTSS_USE_CPU_SI
	bool "Setup CPULD SPI interface"
	default n

config VTSS_REF_CLK_SINGLE_ENDED
	bool "Improve clock for single ended ref clock mode"
	default n

config VTSS_VERIPHY
	bool "VeriPHY process support for ports"
	default n

endif
```

## trunk/tmp/rabox-mk/kern/Kconfig
```kconfig
#
# Netsvc Kernel
#

menu "Kernel Interfaces"
source "kern/netlink/Kconfig"

config SECRET_FILE
	bool "Secret file source support"
	default y
	help
	  Secret module use file as source.

config SECRET_PLAIN
	bool "Secret format - plain"
	default y
	help
	  Secret plain format.
endmenu
```

## trunk/tmp/rabox-mk/lib/Kconfig
```kconfig
#
# Protocol Stacks
#

menu "Crypto Services"
source "lib/smartcard/Kconfig"
source "lib/libusb/Kconfig"
source "lib/ifd_ct/Kconfig"
source "lib/pcsclite/Kconfig"
source "lib/ccid/Kconfig"
endmenu
```
